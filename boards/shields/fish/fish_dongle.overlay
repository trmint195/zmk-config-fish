#include "fish.dtsi"

// Dongle has no physical matrix — disable the gpio kscan and use xiaord's mock kscan.
&kscan0 {
    status = "disabled";
};

/ {
    chosen {
        zmk,kscan = &mock_kscan;
    };
};
