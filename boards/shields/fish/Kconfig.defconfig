## boards/shields/fish/Kconfig.defconfig
```kconfig
# Copyright (c) 2021 The ZMK Contributors
# SPDX-License-Identifier: MIT

if SHIELD_FISH_LEFT || SHIELD_FISH_RIGHT || SHIELD_FISH_DONGLE
    config ZMK_SPLIT
        default y
    config ZMK_KEYBOARD_NAME
        default "Fish"
endif

if SHIELD_FISH_DONGLE
    config ZMK_SPLIT_ROLE_CENTRAL
        default y

    config ZMK_SPLIT_BLE_CENTRAL_PERIPHERALS
        default 2

    # Set this to ZMK_SPLIT_BLE_CENTRAL_PERIPHERALS + your desired number of BT profiles (default is 5)
    config BT_MAX_CONN
        default 7

    # Set this to the same number as BT_MAX_CONN
    config BT_MAX_PAIRED
        default 7

endif
```

## config/west.yml
```yaml
manifest:
  remotes:
    - name: zmkfirmware
      url-base: https://github.com/zmkfirmware
    - name: TakeshiAkehi
      url-base: https://github.com/trmint195
    # Additional modules containing boards/shields/custom code can be listed here as well
    # See https://docs.zephyrproject.org/3.2.0/develop/west/manifest.html#projects
  projects:
    - name: zmk
      remote: zmkfirmware
      revision: main
      import: app/west.yml
    - name: zmk-module-xiaord
      remote: trmint195
      revision: 8080
  self:
    path: config
```
